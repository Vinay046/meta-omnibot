## conf/layer.conf
```bitbake
# We have a conf and classes directory, add to BBPATH
BBPATH .= ":${LAYERDIR}"

# We have recipes-* directories, add to BBFILES
BBFILES += "${LAYERDIR}/recipes-*/*/*.bb \
            ${LAYERDIR}/recipes-*/*/*.bbappend"

BBFILE_COLLECTIONS += "meta-omnibot"
BBFILE_PATTERN_meta-omnibot = "^${LAYERDIR}/"
BBFILE_PRIORITY_meta-omnibot = "6"

LAYERDEPENDS_meta-omnibot = "core"
LAYERSERIES_COMPAT_meta-omnibot = "scarthgap"
```
